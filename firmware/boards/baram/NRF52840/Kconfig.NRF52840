## firmware/nrf52-qmk-fw/boards/baram/NRF52840/Kconfig.NRF52840
```kconfig
config BOARD_NRF52840
	select SOC_NRF52840_QIAA

config BOARD_ENABLE_DCDC
    bool "Enable DCDC mode"
    select SOC_DCDC_NRF52X
    default y

config SAMPLE_USBD_REMOTE_WAKEUP
	default y

# Source common USB sample options used to initialize new experimental USB
# device stack. The scope of these options is limited to USB samples in project
# tree, you cannot use them in your own application.
source "samples/subsys/usb/common/Kconfig.sample_usbd"
```

## firmware/nrf52-qmk-fw/boards/baram/NRF52840/NRF52840_defconfig
```kconfig
CONFIG_ARM_MPU=y
CONFIG_HW_STACK_PROTECTION=y

# 전력 — 지금까지 Zephyr/nRF 기본값에 얹혀 있었다. 기본값은 조용히 바뀔 수 있고
# 무선 키보드에선 이 세 줄이 전류를 좌우하므로 보드 차원에서 못 박는다. (ZMK 보드 관례와 동일)
#
# 이 보드에는 외부 32.768kHz 크리스탈(LFXO)이 있다. LFXO 는 내장 RC 대비 정확하고
# 주기적 캘리브레이션(HFCLK 기동)이 필요 없어 BLE idle 전력에 유리하다.
# ※ 크리스탈 없는 보드를 파생시킬 땐 반드시 K32SRC_RC 로 바꿔야 한다(안 그러면 LFCLK 미기동).
CONFIG_CLOCK_CONTROL_NRF_K32SRC_XTAL=y
CONFIG_CLOCK_CONTROL_NRF_K32SRC_50PPM=y

# DCDC 레귤레이터: LDO 대비 전류 크게 절감.
CONFIG_BOARD_ENABLE_DCDC=y
```

## firmware/nrf52-qmk-fw/boards/baram/wish40/Kconfig.wish40
```kconfig
config BOARD_WISH40
	select SOC_NRF52840_QIAA

config BOARD_ENABLE_DCDC
    bool "Enable DCDC mode"
    select SOC_DCDC_NRF52X
    default y

config SAMPLE_USBD_REMOTE_WAKEUP
	default y

source "samples/subsys/usb/common/Kconfig.sample_usbd"
```

## firmware/nrf52-qmk-fw/boards/baram/wish40/wish40_defconfig
```kconfig
CONFIG_ARM_MPU=y
CONFIG_HW_STACK_PROTECTION=y

# 전력 — 기본값은 조용히 바뀔 수 있고 무선 키보드에선 전류를 좌우하므로 보드에서 못 박는다.
# 외부 32.768kHz 크리스탈(LFXO) 실장 확인됨 — 회로도의 X1(XL1/XL2, 부하 12pF).
CONFIG_CLOCK_CONTROL_NRF_K32SRC_XTAL=y
CONFIG_CLOCK_CONTROL_NRF_K32SRC_50PPM=y

# DCDC 레귤레이터: LDO 대비 전류 크게 절감.
CONFIG_BOARD_ENABLE_DCDC=y

# 배터리 잔량 — **MAX17048 연료게이지**(i2c1 @0x36). VDDH ADC 를 쓰는 wish60/wish65 와 다르다.
# driver/battery.c 가 DT_HAS_COMPAT_STATUS_OKAY(maxim_max17048) 로 백엔드를 자동 선택한다.
CONFIG_I2C=y
CONFIG_FUEL_GAUGE=y
CONFIG_MAX17048=y

# BLE Device Information Service — **보드마다 다른 값**(prj.conf 는 공유라 여기 둔다).
# 키보드 config.h 의 KBD_NAME / USB_PID 와 반드시 일치할 것 — port/ble.c 의 BUILD_ASSERT 가 잡는다.
CONFIG_BT_DIS_MODEL_NUMBER=y
CONFIG_BT_DIS_MODEL_NUMBER_STR="WISH40"
CONFIG_BT_DIS_PNP_PID=0x520A
```

## firmware/nrf52-qmk-fw/boards/baram/wish60/wish60_defconfig
```kconfig
CONFIG_ARM_MPU=y
CONFIG_HW_STACK_PROTECTION=y

# 전력 — 지금까지 Zephyr/nRF 기본값에 얹혀 있었다. 기본값은 조용히 바뀔 수 있고
# 무선 키보드에선 이 세 줄이 전류를 좌우하므로 보드 차원에서 못 박는다. (ZMK 보드 관례와 동일)
#
# 이 보드에는 외부 32.768kHz 크리스탈(LFXO)이 있다. LFXO 는 내장 RC 대비 정확하고
# 주기적 캘리브레이션(HFCLK 기동)이 필요 없어 BLE idle 전력에 유리하다.
# ※ 크리스탈 없는 보드를 파생시킬 땐 반드시 K32SRC_RC 로 바꿔야 한다(안 그러면 LFCLK 미기동).
CONFIG_CLOCK_CONTROL_NRF_K32SRC_XTAL=y
CONFIG_CLOCK_CONTROL_NRF_K32SRC_50PPM=y

# DCDC 레귤레이터: LDO 대비 전류 크게 절감.
CONFIG_BOARD_ENABLE_DCDC=y

# BLE Device Information Service — **보드마다 다른 값**(prj.conf 는 공유라 여기 둔다).
# 예전엔 모델명이 공통 prj.conf 의 "nrf52840" 이라 wish65 도 그렇게 광고했다(거짓말).
# 아래 두 값은 키보드 config.h 의 KBD_NAME / USB_PID 와 **반드시 일치**해야 한다 —
# 어긋나면 port/ble.c 의 BUILD_ASSERT 가 잡는다(DIS 는 Kconfig 로만 설정돼 C 값을 못 읽는다).
CONFIG_BT_DIS_MODEL_NUMBER=y
CONFIG_BT_DIS_MODEL_NUMBER_STR="WISH60"
CONFIG_BT_DIS_PNP_PID=0x5208

# 배터리 연료게이지 — MAX17048(i2c1 @0x36). VDDH ADC 에서 전환(검증용). driver/battery.c 가
# DT 로 백엔드를 자동 선택하므로 여기 Kconfig 만 켜면 된다.
CONFIG_I2C=y
CONFIG_FUEL_GAUGE=y
CONFIG_MAX17048=y
```

## firmware/nrf52-qmk-fw/boards/baram/wish65/Kconfig.wish65
```kconfig
config BOARD_WISH65
	select SOC_NRF52833_QIAA

config BOARD_ENABLE_DCDC
    bool "Enable DCDC mode"
    select SOC_DCDC_NRF52X
    default y

config SAMPLE_USBD_REMOTE_WAKEUP
	default y

source "samples/subsys/usb/common/Kconfig.sample_usbd"
```

## firmware/nrf52-qmk-fw/boards/baram/wish65/wish65_defconfig
```kconfig
CONFIG_ARM_MPU=y
CONFIG_HW_STACK_PROTECTION=y

# 전력 — wish60_defconfig 와 같은 이유로 보드 차원에서 못 박는다(기본값은 조용히 바뀐다).
#
# 외부 32.768kHz 크리스탈(LFXO) 실장 확인됨 — 회로도의 X2(XL1/XL2, 부하 12pF).
# LFXO 는 내장 RC 대비 정확하고 주기적 캘리브레이션(HFCLK 기동)이 없어 BLE idle 전력에 유리하다.
# ※ 크리스탈 없는 보드를 파생시킬 땐 반드시 K32SRC_RC 로 바꿀 것(안 그러면 LFCLK 미기동).
CONFIG_CLOCK_CONTROL_NRF_K32SRC_XTAL=y
CONFIG_CLOCK_CONTROL_NRF_K32SRC_50PPM=y

# DCDC 레귤레이터: LDO 대비 전류 크게 절감.
CONFIG_BOARD_ENABLE_DCDC=y

# BLE Device Information Service — **보드마다 다른 값**(prj.conf 는 공유라 여기 둔다).
# 예전엔 모델명이 공통 prj.conf 의 "nrf52840" 이라 wish65 도 그렇게 광고했다(거짓말).
# 아래 두 값은 키보드 config.h 의 KBD_NAME / USB_PID 와 **반드시 일치**해야 한다 —
# 어긋나면 port/ble.c 의 BUILD_ASSERT 가 잡는다(DIS 는 Kconfig 로만 설정돼 C 값을 못 읽는다).
CONFIG_BT_DIS_MODEL_NUMBER=y
CONFIG_BT_DIS_MODEL_NUMBER_STR="WISH65"
CONFIG_BT_DIS_PNP_PID=0x5209
```
